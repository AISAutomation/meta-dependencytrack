## conf/layer.conf
```bitbake
# SPDX-License-Identifier: MIT
# Copyright 2022 BG Networks, Inc.
£ Copyright 2024 Laerdal Medical AS

BBPATH .= ":${LAYERDIR}"

LAYERSERIES_COMPAT_bgnetworks = " honister kirkstone"

BGNETWORKS_LAYERDIR := "${LAYERDIR}"
```
